# 1 "arch/arm/boot/dts/imx6ull-e60u22a10.dts"
# 1 "<built-in>"
# 1 "<command-line>"
# 31 "<command-line>"
# 1 "/usr/include/stdc-predef.h" 1 3 4
# 32 "<command-line>" 2
# 1 "arch/arm/boot/dts/imx6ull-e60u22a10.dts"

# 1 "arch/arm/boot/dts/imx6ull-e60u22a10-base.dts" 1
# 9 "arch/arm/boot/dts/imx6ull-e60u22a10-base.dts"
/dts-v1/;

# 1 "include/dt-bindings/input/input.h" 1
# 13 "include/dt-bindings/input/input.h"
# 1 "include/dt-bindings/input/linux-event-codes.h" 1
# 14 "include/dt-bindings/input/input.h" 2
# 12 "arch/arm/boot/dts/imx6ull-e60u22a10-base.dts" 2
# 1 "arch/arm/boot/dts/imx6ull-ntx.dtsi" 1
# 9 "arch/arm/boot/dts/imx6ull-ntx.dtsi"
# 1 "include/dt-bindings/clock/imx6ul-clock.h" 1
# 10 "arch/arm/boot/dts/imx6ull-ntx.dtsi" 2
# 1 "include/dt-bindings/gpio/gpio.h" 1
# 11 "arch/arm/boot/dts/imx6ull-ntx.dtsi" 2
# 1 "include/dt-bindings/interrupt-controller/arm-gic.h" 1







# 1 "include/dt-bindings/interrupt-controller/irq.h" 1
# 9 "include/dt-bindings/interrupt-controller/arm-gic.h" 2
# 12 "arch/arm/boot/dts/imx6ull-ntx.dtsi" 2
# 1 "arch/arm/boot/dts/imx6ull-pinfunc.h" 1
# 12 "arch/arm/boot/dts/imx6ull-pinfunc.h"
# 1 "arch/arm/boot/dts/imx6ul-pinfunc.h" 1
# 13 "arch/arm/boot/dts/imx6ull-pinfunc.h" 2
# 13 "arch/arm/boot/dts/imx6ull-ntx.dtsi" 2
# 1 "arch/arm/boot/dts/imx6ull-pinfunc-snvs.h" 1
# 14 "arch/arm/boot/dts/imx6ull-ntx.dtsi" 2
# 1 "arch/arm/boot/dts/skeleton.dtsi" 1






/ {


 chosen { };
 aliases { };
 memory { device_type = "memory"; reg = <0 0>; };
};
# 15 "arch/arm/boot/dts/imx6ull-ntx.dtsi" 2

/ {
 aliases {
  can0 = &flexcan1;
  can1 = &flexcan2;
  ethernet0 = &fec1;
  ethernet1 = &fec2;
  gpio0 = &gpio1;
  gpio1 = &gpio2;
  gpio2 = &gpio3;
  gpio3 = &gpio4;
  gpio4 = &gpio5;
  i2c0 = &i2c1;
  i2c1 = &i2c2;
  i2c2 = &i2c3;
  i2c3 = &i2c4;
  mmc0 = &usdhc1;
  mmc1 = &usdhc2;
  serial0 = &uart1;
  serial1 = &uart2;
  serial2 = &uart3;
  serial3 = &uart4;
  serial4 = &uart5;
  serial5 = &uart6;
  serial6 = &uart7;
  serial7 = &uart8;
  spi0 = &ecspi1;
  spi1 = &ecspi2;
  spi2 = &ecspi3;
  spi3 = &ecspi4;
  usbphy0 = &usbphy1;
  usbphy1 = &usbphy2;
 };

 cpus {



  cpu0: cpu@0 {
   compatible = "arm,cortex-a7";
   device_type = "cpu";
   reg = <0>;
   clock-latency = <61036>;
   operating-points = <

    528000 1175000
    396000 1025000
    198000 950000
   >;
   fsl,soc-operating-points = <

    528000 1175000
    396000 1175000
    198000 1175000
   >;
   fsl,low-power-run;
   clocks = <&clks 93>,
     <&clks 26>,
     <&clks 38>,
     <&clks 219>,
     <&clks 56>,
     <&clks 57>,
     <&clks 25>,
     <&clks 18>,
     <&clks 11>,
     <&clks 4>,
     <&clks 3>;
   clock-names = "arm", "pll2_bus", "pll2_pfd2_396m", "secondary_sel", "step",
          "pll1_sw", "pll1_sys", "pll1_bypass", "pll1", "pll1_bypass_src", "osc";
  };
 };

 intc: interrupt-controller@00a01000 {
  compatible = "arm,cortex-a7-gic";

  interrupt-controller;
  reg = <0x00a01000 0x1000>,
        <0x00a02000 0x100>;
 };

 clocks {



  ckil: clock@0 {
   compatible = "fixed-clock";
   reg = <0>;

   clock-frequency = <32768>;
   clock-output-names = "ckil";
  };

  osc: clock@1 {
   compatible = "fixed-clock";
   reg = <1>;

   clock-frequency = <24000000>;
   clock-output-names = "osc";
  };

  ipp_di0: clock@2 {
   compatible = "fixed-clock";
   reg = <2>;

   clock-frequency = <0>;
   clock-output-names = "ipp_di0";
  };

  ipp_di1: clock@3 {
   compatible = "fixed-clock";
   reg = <3>;

   clock-frequency = <0>;
   clock-output-names = "ipp_di1";
  };
 };

 soc {


  compatible = "simple-bus";
  interrupt-parent = <&gpc>;
  ranges;

  busfreq {
   compatible = "fsl,imx_busfreq";
   clocks = <&clks 38>, <&clks 53>,
     <&clks 26>, <&clks 93>,
     <&clks 27>, <&clks 85>,
     <&clks 60>, <&clks 94>,
     <&clks 62>, <&clks 3>,
     <&clks 96>, <&clks 212>,
     <&clks 86>, <&clks 61>,
     <&clks 95>, <&clks 63>,
     <&clks 56>, <&clks 163>, <&clks 4>,
     <&clks 18>, <&clks 25>, <&clks 57>,
     <&clks 11>;
   clock-names = "pll2_pfd2_396m", "pll2_198m", "pll2_bus", "arm", "pll3_usb_otg",
          "periph", "periph_pre", "periph_clk2", "periph_clk2_sel", "osc",
          "ahb", "ocram", "periph2", "periph2_pre", "periph2_clk2", "periph2_clk2_sel",
          "step", "mmdc", "pll1_bypass_src", "pll1_bypass", "pll1_sys", "pll1_sw", "pll1";
   fsl,max_ddr_freq = <400000000>;
  };

  pmu {
   compatible = "arm,cortex-a7-pmu";
   interrupts = <0 94 4>;
   status = "disabled";
  };

  ocrams: sram@00900000 {
   compatible = "fsl,lpm-sram";
   reg = <0x00900000 0x4000>;
  };

  ocrams_ddr: sram@00904000 {
   compatible = "fsl,ddr-lpm-sram";
   reg = <0x00904000 0x1000>;
  };

  ocram: sram@00905000 {
   compatible = "mmio-sram";
   reg = <0x00905000 0x1B000>;
  };

  dma_apbh: dma-apbh@01804000 {
   compatible = "fsl,imx6ul-dma-apbh", "fsl,imx28-dma-apbh";
   reg = <0x01804000 0x2000>;
   interrupts = <0 13 4>,
         <0 13 4>,
         <0 13 4>,
         <0 13 4>;
   interrupt-names = "gpmi0", "gpmi1", "gpmi2", "gpmi3";

   dma-channels = <4>;
   clocks = <&clks 128>;
  };

  gpmi: gpmi-nand@01806000{
   compatible = "fsl,imx6ull-gpmi-nand", "fsl, imx6ul-gpmi-nand";


   reg = <0x01806000 0x2000>, <0x01808000 0x4000>;
   reg-names = "gpmi-nand", "bch";
   interrupts = <0 15 4>;
   interrupt-names = "bch";
   clocks = <&clks 133>,
     <&clks 134>,
     <&clks 132>,
     <&clks 131>,
     <&clks 220>;
   clock-names = "gpmi_io", "gpmi_apb", "gpmi_bch",
          "gpmi_bch_apb", "per1_bch";
   dmas = <&dma_apbh 0>;
   dma-names = "rx-tx";
   status = "disabled";
  };

  aips1: aips-bus@02000000 {
   compatible = "fsl,aips-bus", "simple-bus";


   reg = <0x02000000 0x100000>;
   ranges;

   spba-bus@02000000 {
    compatible = "fsl,spba-bus", "simple-bus";


    reg = <0x02000000 0x40000>;
    ranges;

    spdif: spdif@02004000 {
     compatible = "fsl,imx6ul-spdif", "fsl,imx35-spdif";
     reg = <0x02004000 0x4000>;
     interrupts = <0 52 4>;
     dmas = <&sdma 41 18 0>,
            <&sdma 42 18 0>;
     dma-names = "rx", "tx";
     clocks = <&clks 213>,
       <&clks 3>,
       <&clks 188>,
       <&clks 0>, <&clks 0>, <&clks 0>,
       <&clks 100>,
       <&clks 0>, <&clks 0>,
       <&clks 187>;
     clock-names = "core", "rxtx0",
            "rxtx1", "rxtx2",
            "rxtx3", "rxtx4",
            "rxtx5", "rxtx6",
            "rxtx7", "dma";
     status = "disabled";
    };

    ecspi1: ecspi@02008000 {


     compatible = "fsl,imx6ul-ecspi", "fsl,imx51-ecspi";
     reg = <0x02008000 0x4000>;
     interrupts = <0 31 4>;
     clocks = <&clks 139>,
       <&clks 139>;
     clock-names = "ipg", "per";
     dmas = <&sdma 3 7 1>, <&sdma 4 7 2>;
     dma-names = "rx", "tx";
     status = "disabled";
    };

    ecspi2: ecspi@0200c000 {


     compatible = "fsl,imx6ul-ecspi", "fsl,imx51-ecspi";
     reg = <0x0200c000 0x4000>;
     interrupts = <0 32 4>;
     clocks = <&clks 140>,
       <&clks 140>;
     clock-names = "ipg", "per";
     dmas = <&sdma 5 7 1>, <&sdma 6 7 2>;
     dma-names = "rx", "tx";
     status = "disabled";
    };

    ecspi3: ecspi@02010000 {


     compatible = "fsl,imx6ul-ecspi", "fsl,imx51-ecspi";
     reg = <0x02010000 0x4000>;
     interrupts = <0 33 4>;
     clocks = <&clks 141>,
       <&clks 141>;
     clock-names = "ipg", "per";
     dmas = <&sdma 7 7 1>, <&sdma 8 7 2>;
     dma-names = "rx", "tx";
     status = "disabled";
    };

    ecspi4: ecspi@02014000 {


     compatible = "fsl,imx6ul-ecspi", "fsl,imx51-ecspi";
     reg = <0x02014000 0x4000>;
     interrupts = <0 34 4>;
     clocks = <&clks 142>,
       <&clks 142>;
     clock-names = "ipg", "per";
     dmas = <&sdma 9 7 1>, <&sdma 10 7 2>;
     dma-names = "rx", "tx";
     status = "disabled";
    };

    uart7: serial@02018000 {
     compatible = "fsl,imx6ul-uart",
           "fsl,imx6q-uart", "fsl,imx21-uart";
     reg = <0x02018000 0x4000>;
     interrupts = <0 39 4>;
     clocks = <&clks 201>,
       <&clks 202>;
     clock-names = "ipg", "per";
     dmas = <&sdma 43 4 0>, <&sdma 44 4 0>;
     dma-names = "rx", "tx";
     status = "disabled";
    };

    uart1: serial@02020000 {
     compatible = "fsl,imx6ul-uart",
           "fsl,imx6q-uart", "fsl,imx21-uart";
     reg = <0x02020000 0x4000>;
     interrupts = <0 26 4>;
     clocks = <&clks 189>,
       <&clks 190>;
     clock-names = "ipg", "per";
     status = "disabled";
    };

    esai: esai@02024000 {
     compatible = "fsl,imx6ull-esai";
     reg = <0x02024000 0x4000>;
     interrupts = <0 51 4>;
     clocks = <&clks 229>,
       <&clks 228>,
       <&clks 227>,
       <&clks 229>,
       <&clks 187>;
     clock-names = "core", "mem", "extal",
            "fsys", "dma";
     dmas = <&sdma 0 21 0>, <&sdma 47 21 0>;
     dma-names = "rx", "tx";
     dma-source = <&gpr 0 14 0 15>;
     status = "disabled";
    };

    sai1: sai@02028000 {
     compatible = "fsl,imx6ul-sai",
           "fsl,imx6sx-sai";
     reg = <0x02028000 0x4000>;
     interrupts = <0 97 4>;
     clocks = <&clks 179>,
       <&clks 0>,
       <&clks 178>,
       <&clks 0>, <&clks 0>;
     clock-names = "bus", "mclk0", "mclk1", "mclk2", "mclk3";
     dma-names = "rx", "tx";
     dmas = <&sdma 35 24 0>, <&sdma 36 24 0>;
     status = "disabled";
    };

    sai2: sai@0202c000 {
     compatible = "fsl,imx6ul-sai",
           "fsl,imx6sx-sai";
     reg = <0x0202c000 0x4000>;
     interrupts = <0 98 4>;
     clocks = <&clks 181>,
       <&clks 0>,
       <&clks 180>,
       <&clks 0>, <&clks 0>;
     clock-names = "bus", "mclk0", "mclk1", "mclk2", "mclk3";
     dma-names = "rx", "tx";
     dmas = <&sdma 37 24 0>, <&sdma 38 24 0>;
     status = "disabled";
    };

    sai3: sai@02030000 {
     compatible = "fsl,imx6ul-sai",
           "fsl,imx6sx-sai";
     reg = <0x02030000 0x4000>;
     interrupts = <0 24 4>;
     clocks = <&clks 183>,
       <&clks 0>,
       <&clks 182>,
       <&clks 0>, <&clks 0>;
     clock-names = "bus", "mclk0", "mclk1", "mclk2", "mclk3";
     dma-names = "rx", "tx";
     dmas = <&sdma 39 24 0>, <&sdma 40 24 0>;
     status = "disabled";
    };

    asrc: asrc@02034000 {
     compatible = "fsl,imx53-asrc";
     reg = <0x02034000 0x4000>;
     interrupts = <0 50 4>;
     clocks = <&clks 129>,
      <&clks 130>, <&clks 0>,
      <&clks 0>, <&clks 0>, <&clks 0>, <&clks 0>,
      <&clks 0>, <&clks 0>, <&clks 0>, <&clks 0>,
      <&clks 0>, <&clks 0>, <&clks 0>, <&clks 0>,
      <&clks 188>, <&clks 0>, <&clks 0>,
      <&clks 187>;
     clock-names = "mem", "ipg", "asrck_0",
      "asrck_1", "asrck_2", "asrck_3", "asrck_4",
      "asrck_5", "asrck_6", "asrck_7", "asrck_8",
      "asrck_9", "asrck_a", "asrck_b", "asrck_c",
      "asrck_d", "asrck_e", "asrck_f", "dma";
     dmas = <&sdma 17 23 1>, <&sdma 18 23 1>, <&sdma 19 23 1>,
      <&sdma 20 23 1>, <&sdma 21 23 1>, <&sdma 22 23 1>;
     dma-names = "rxa", "rxb", "rxc",
          "txa", "txb", "txc";
     fsl,asrc-rate = <48000>;
     fsl,asrc-width = <16>;
     status = "okay";
    };
   };

   tsc: tsc@02040000 {
    compatible = "fsl,imx6ul-tsc";
    reg = <0x02040000 0x4000>, <0x0219c000 0x4000>;
    interrupts = <0 3 4>,
          <0 101 4>;
    clocks = <&clks 100>,
      <&clks 124>;
    clock-names = "tsc", "adc";
    status = "disabled";
   };

   pwm1: pwm@02080000 {
    compatible = "fsl,imx6ul-pwm", "fsl,imx27-pwm";
    reg = <0x02080000 0x4000>;
    interrupts = <0 83 4>;
    clocks = <&clks 167>,
      <&clks 167>;
    clock-names = "ipg", "per";

   };

   pwm2: pwm@02084000 {
    compatible = "fsl,imx6ul-pwm", "fsl,imx27-pwm";
    reg = <0x02084000 0x4000>;
    interrupts = <0 84 4>;
    clocks = <&clks 0>,
      <&clks 0>;
    clock-names = "ipg", "per";

   };

   pwm3: pwm@02088000 {
    compatible = "fsl,imx6ul-pwm", "fsl,imx27-pwm";
    reg = <0x02088000 0x4000>;
    interrupts = <0 85 4>;
    clocks = <&clks 169>,
      <&clks 169>;
    clock-names = "ipg", "per";

   };

   pwm4: pwm@0208c000 {
    compatible = "fsl,imx6ul-pwm", "fsl,imx27-pwm";
    reg = <0x0208c000 0x4000>;
    interrupts = <0 86 4>;
    clocks = <&clks 0>,
      <&clks 0>;
    clock-names = "ipg", "per";

   };

   flexcan1: can@02090000 {
    compatible = "fsl,imx6ul-flexcan", "fsl,imx6q-flexcan";
    reg = <0x02090000 0x4000>;
    interrupts = <0 110 4>;
    clocks = <&clks 148>,
      <&clks 149>;
    clock-names = "ipg", "per";
    stop-mode = <&gpr 0x10 1 0x10 17>;
    status = "disabled";
   };

   flexcan2: can@02094000 {
    compatible = "fsl,imx6ul-flexcan", "fsl,imx6q-flexcan";
    reg = <0x02094000 0x4000>;
    interrupts = <0 111 4>;
    clocks = <&clks 150>,
      <&clks 151>;
    clock-names = "ipg", "per";
    stop-mode = <&gpr 0x10 2 0x10 18>;
    status = "disabled";
   };

   gpt1: gpt@02098000 {
    compatible = "fsl,imx6ul-gpt", "fsl,imx31-gpt";
    reg = <0x02098000 0x4000>;
    interrupts = <0 55 4>;
    clocks = <&clks 152>,
      <&clks 153>;
    clock-names = "ipg", "per";
   };

   gpio1: gpio@0209c000 {
    compatible = "fsl,imx6ul-gpio", "fsl,imx35-gpio";
    reg = <0x0209c000 0x4000>;
    interrupts = <0 66 4>,
          <0 67 4>;
    gpio-controller;

    interrupt-controller;

   };

   gpio2: gpio@020a0000 {
    compatible = "fsl,imx6ul-gpio", "fsl,imx35-gpio";
    reg = <0x020a0000 0x4000>;
    interrupts = <0 68 4>,
          <0 69 4>;
    gpio-controller;

    interrupt-controller;

   };

   gpio3: gpio@020a4000 {
    compatible = "fsl,imx6ul-gpio", "fsl,imx35-gpio";
    reg = <0x020a4000 0x4000>;
    interrupts = <0 70 4>,
          <0 71 4>;
    gpio-controller;

    interrupt-controller;

   };

   gpio4: gpio@020a8000 {
    compatible = "fsl,imx6ul-gpio", "fsl,imx35-gpio";
    reg = <0x020a8000 0x4000>;
    interrupts = <0 72 4>,
          <0 73 4>;
    gpio-controller;

    interrupt-controller;

   };

   gpio5: gpio@020ac000 {
    compatible = "fsl,imx6ul-gpio", "fsl,imx35-gpio";
    reg = <0x020ac000 0x4000>;
    interrupts = <0 74 4>,
          <0 75 4>;
    gpio-controller;

    interrupt-controller;

   };

   snvslp: snvs@020b0000 {
    compatible = "fsl,imx6ul-snvs";
    reg = <0x020b0000 0x4000>;
    interrupts = <0 4 4>;
   };

   fec2: ethernet@020b4000 {
    compatible = "fsl,imx6ul-fec", "fsl,imx6q-fec";
    reg = <0x020b4000 0x4000>;
    interrupts = <0 120 4>,
          <0 121 4>;
    clocks = <&clks 144>,
      <&clks 145>,
      <&clks 48>,
      <&clks 46>,
      <&clks 46>;
    clock-names = "ipg", "ahb", "ptp",
           "enet_clk_ref", "enet_out";
    stop-mode = <&gpr 0x10 4>;
    fsl,num-tx-queues=<1>;
    fsl,num-rx-queues=<1>;
    fsl,magic-packet;
    fsl,wakeup_irq = <0>;
    status = "disabled";
   };

   kpp: kpp@020b8000 {
    compatible = "fsl,imx6ul-kpp", "fsl,imx21-kpp";
    reg = <0x020b8000 0x4000>;
    interrupts = <0 82 4>;
    clocks = <&clks 0>;
    status = "disabled";
   };

   wdog1: wdog@020bc000 {
    compatible = "fsl,imx6ul-wdt", "fsl,imx21-wdt";
    reg = <0x020bc000 0x4000>;
    interrupts = <0 80 4>;
    clocks = <&clks 208>;
   };

   wdog2: wdog@020c0000 {
    compatible = "fsl,imx6ul-wdt", "fsl,imx21-wdt";
    reg = <0x020c0000 0x4000>;
    interrupts = <0 81 4>;
    clocks = <&clks 209>;
    status = "disabled";
   };

   clks: ccm@020c4000 {
    compatible = "fsl,imx6ul-ccm";
    reg = <0x020c4000 0x4000>;
    interrupts = <0 87 4>,
          <0 88 4>;

    clocks = <&ckil>, <&osc>, <&ipp_di0>, <&ipp_di1>;
    clock-names = "ckil", "osc", "ipp_di0", "ipp_di1";
   };

   anatop: anatop@020c8000 {
    compatible = "fsl,imx6ul-anatop", "fsl,imx6q-anatop",
          "syscon", "simple-bus";
    reg = <0x020c8000 0x1000>;
    interrupts = <0 49 4>,
          <0 54 4>,
          <0 127 4>;

    reg_3p0: regulator-3p0@120 {
     compatible = "fsl,anatop-regulator";
     regulator-name = "vdd3p0";
     regulator-min-microvolt = <2625000>;
     regulator-max-microvolt = <3400000>;
     anatop-reg-offset = <0x120>;
     anatop-vol-bit-shift = <8>;
     anatop-vol-bit-width = <5>;
     anatop-min-bit-val = <0>;
     anatop-min-voltage = <2625000>;
     anatop-max-voltage = <3400000>;
     anatop-enable-bit = <0>;
    };

    reg_arm: regulator-vddcore@140 {
     compatible = "fsl,anatop-regulator";
     regulator-name = "cpu";
     regulator-min-microvolt = <725000>;
     regulator-max-microvolt = <1450000>;
     regulator-always-on;
     anatop-reg-offset = <0x140>;
     anatop-vol-bit-shift = <0>;
     anatop-vol-bit-width = <5>;
     anatop-delay-reg-offset = <0x170>;
     anatop-delay-bit-shift = <24>;
     anatop-delay-bit-width = <2>;
     anatop-min-bit-val = <1>;
     anatop-min-voltage = <725000>;
     anatop-max-voltage = <1450000>;
    };

    reg_soc: regulator-vddsoc@140 {
     compatible = "fsl,anatop-regulator";
     regulator-name = "vddsoc";
     regulator-min-microvolt = <725000>;
     regulator-max-microvolt = <1450000>;
     regulator-always-on;
     anatop-reg-offset = <0x140>;
     anatop-vol-bit-shift = <18>;
     anatop-vol-bit-width = <5>;
     anatop-delay-reg-offset = <0x170>;
     anatop-delay-bit-shift = <28>;
     anatop-delay-bit-width = <2>;
     anatop-min-bit-val = <1>;
     anatop-min-voltage = <725000>;
     anatop-max-voltage = <1450000>;
    };
   };

   usbphy1: usbphy@020c9000 {
    compatible = "fsl,imx6ul-usbphy", "fsl,imx23-usbphy";
    reg = <0x020c9000 0x1000>;
    interrupts = <0 44 4>;
    clocks = <&clks 32>;
    phy-3p0-supply = <&reg_3p0>;
    fsl,anatop = <&anatop>;
   };

   usbphy2: usbphy@020ca000 {
    compatible = "fsl,imx6ul-usbphy", "fsl,imx23-usbphy";
    reg = <0x020ca000 0x1000>;
    interrupts = <0 45 4>;
    clocks = <&clks 33>;
    phy-3p0-supply = <&reg_3p0>;
    fsl,anatop = <&anatop>;
   };

   tempmon: tempmon {
    compatible = "fsl,imx6ul-tempmon", "fsl,imx6sx-tempmon";
    interrupts = <0 49 4>;
    fsl,tempmon = <&anatop>;
    fsl,tempmon-data = <&ocotp>;
    clocks = <&clks 27>;
   };

   snvs: snvs@020cc000 {
    compatible = "fsl,sec-v4.0-mon", "syscon", "simple-mfd";
    reg = <0x020cc000 0x4000>;

    snvs_rtc: snvs-rtc-lp {
     compatible = "fsl,sec-v4.0-mon-rtc-lp";
     regmap = <&snvs>;
     offset = <0x34>;
     interrupts = <0 19 4>, <0 20 4>;
    };

    snvs_poweroff: snvs-poweroff {
     compatible = "syscon-poweroff";
     regmap = <&snvs>;
     offset = <0x38>;
     mask = <0x61>;
    };
# 723 "arch/arm/boot/dts/imx6ull-ntx.dtsi"
   };

   epit1: epit@020d0000 {
    reg = <0x020d0000 0x4000>;
    interrupts = <0 56 4>;
   };

   epit2: epit@020d4000 {
    reg = <0x020d4000 0x4000>;
    interrupts = <0 57 4>;
   };

   src: src@020d8000 {
    compatible = "fsl,imx6ul-src", "fsl,imx51-src";
    reg = <0x020d8000 0x4000>;
    interrupts = <0 91 4>,
          <0 96 4>;

   };

   gpc: gpc@020dc000 {
    compatible = "fsl,imx6ul-gpc", "fsl,imx6q-gpc";
    reg = <0x020dc000 0x4000>;
    interrupt-controller;

    interrupts = <0 89 4>;
    interrupt-parent = <&intc>;
    fsl,mf-mix-wakeup-irq = <0xfc00000 0x7d00 0x0 0x1400640>;
   };

   iomuxc: iomuxc@020e0000 {
    compatible = "fsl,imx6ul-iomuxc";
    reg = <0x020e0000 0x4000>;
   };

   gpr: iomuxc-gpr@020e4000 {
    compatible = "fsl,imx6ul-iomuxc-gpr",
     "fsl,imx6q-iomuxc-gpr", "syscon";
    reg = <0x020e4000 0x4000>;
   };

   mqs: mqs {
    compatible = "fsl,imx6sx-mqs";
    gpr = <&gpr>;
    status = "disabled";
   };

   gpt2: gpt@020e8000 {
    compatible = "fsl,imx6ul-gpt", "fsl,imx31-gpt";
    reg = <0x020e8000 0x4000>;
    interrupts = <0 109 4>;
    clocks = <&clks 0>,
      <&clks 0>;
    clock-names = "ipg", "per";
   };

   sdma: sdma@020ec000 {
    compatible = "fsl,imx6ul-sdma", "fsl,imx35-sdma";
    reg = <0x020ec000 0x4000>;
    interrupts = <0 2 4>;
    clocks = <&clks 184>,
      <&clks 184>;
    clock-names = "ipg", "ahb";

    iram = <&ocram>;
    fsl,sdma-ram-script-name = "imx/sdma/sdma-imx6q.bin";
   };

   pwm5: pwm@020f0000 {
    compatible = "fsl,imx6ul-pwm", "fsl,imx27-pwm";
    reg = <0x020f0000 0x4000>;
    interrupts = <0 114 4>;
    clocks = <&clks 0>,
      <&clks 0>;
    clock-names = "ipg", "per";

   };

   pwm6: pwm@020f4000 {
    compatible = "fsl,imx6ul-pwm", "fsl,imx27-pwm";
    reg = <0x020f4000 0x4000>;
    interrupts = <0 115 4>;
    clocks = <&clks 0>,
      <&clks 0>;
    clock-names = "ipg", "per";

   };

   pwm7: pwm@020f8000 {
    compatible = "fsl,imx6ul-pwm", "fsl,imx27-pwm";
    reg = <0x020f8000 0x4000>;
    interrupts = <0 116 4>;
    clocks = <&clks 0>,
      <&clks 0>;
    clock-names = "ipg", "per";

   };

   pwm8: pwm@020fc000 {
    compatible = "fsl,imx6ul-pwm", "fsl,imx27-pwm";
    reg = <0x020fc000 0x4000>;
    interrupts = <0 117 4>;
    clocks = <&clks 0>,
      <&clks 0>;
    clock-names = "ipg", "per";

   };
  };

  aips2: aips-bus@02100000 {
   compatible = "fsl,aips-bus", "simple-bus";


   reg = <0x02100000 0x100000>;
   ranges;

   usbotg1: usb@02184000 {
    compatible = "fsl,imx6ul-usb", "fsl,imx27-usb";
    reg = <0x02184000 0x200>;
    interrupts = <0 43 4>;
    clocks = <&clks 205>;
    fsl,usbphy = <&usbphy1>;
    fsl,usbmisc = <&usbmisc 0>;
    fsl,anatop = <&anatop>;
    ahb-burst-config = <0x0>;
    tx-burst-size-dword = <0x10>;
    rx-burst-size-dword = <0x10>;
    status = "disabled";
   };

   usbotg2: usb@02184200 {
    compatible = "fsl,imx6ul-usb", "fsl,imx27-usb";
    reg = <0x02184200 0x200>;
    interrupts = <0 42 4>;
    clocks = <&clks 205>;
    fsl,usbphy = <&usbphy2>;
    fsl,usbmisc = <&usbmisc 1>;
    ahb-burst-config = <0x0>;
    tx-burst-size-dword = <0x10>;
    rx-burst-size-dword = <0x10>;
    status = "disabled";
   };

   usbmisc: usbmisc@02184800 {

    compatible = "fsl,imx6ul-usbmisc", "fsl,imx6q-usbmisc";
    reg = <0x02184800 0x200>;
   };

   fec1: ethernet@02188000 {
    compatible = "fsl,imx6ul-fec", "fsl,imx6q-fec";
    reg = <0x02188000 0x4000>;
    interrupts = <0 118 4>,
          <0 119 4>;
    clocks = <&clks 144>,
      <&clks 145>,
      <&clks 48>,
      <&clks 44>,
      <&clks 44>;
    clock-names = "ipg", "ahb", "ptp",
           "enet_clk_ref", "enet_out";
    stop-mode = <&gpr 0x10 3>;
    fsl,num-tx-queues=<1>;
    fsl,num-rx-queues=<1>;
    fsl,magic-packet;
    fsl,wakeup_irq = <0>;
    status = "disabled";
                        };

   usdhc1: usdhc@02190000 {
    compatible = "fsl,imx6ul-usdhc", "fsl,imx6sx-usdhc";
    reg = <0x02190000 0x4000>;
    interrupts = <0 22 4>;
    clocks = <&clks 206>,
      <&clks 206>,
      <&clks 206>;
    clock-names = "ipg", "ahb", "per";
    bus-width = <4>;
    fsl,tuning-step= <2>;
    status = "disabled";
   };

   usdhc2: usdhc@02194000 {
    compatible = "fsl,imx6ul-usdhc", "fsl,imx6sx-usdhc";
    reg = <0x02194000 0x4000>;
    interrupts = <0 23 4>;
    clocks = <&clks 207>,
      <&clks 207>,
      <&clks 207>;
    clock-names = "ipg", "ahb", "per";
    bus-width = <4>;
    fsl,tuning-step= <2>;
    status = "disabled";
   };

   adc1: adc@02198000 {
    compatible = "fsl,imx6ul-adc", "fsl,vf610-adc";
    reg = <0x02198000 0x4000>;
    interrupts = <0 100 4>;
    clocks = <&clks 123>;
    num-channels = <2>;
    clock-names = "adc";
    status = "disabled";
                        };

   i2c1: i2c@021a0000 {


    compatible = "fsl,imx6ul-i2c", "fsl,imx21-i2c";
    reg = <0x021a0000 0x4000>;
    interrupts = <0 36 4>;
    clocks = <&clks 156>;
    status = "disabled";
   };

   i2c2: i2c@021a4000 {


    compatible = "fsl,imx6ul-i2c", "fsl,imx21-i2c";
    reg = <0x021a4000 0x4000>;
    interrupts = <0 37 4>;
    clocks = <&clks 157>;
    status = "disabled";
   };

   i2c3: i2c@021a8000 {


    compatible = "fsl,imx6ul-i2c", "fsl,imx21-i2c";
    reg = <0x021a8000 0x4000>;
    interrupts = <0 38 4>;
    clocks = <&clks 158>;
    status = "disabled";
   };

   romcp@021ac000 {
    compatible = "fsl,imx6ul-romcp", "syscon";
    reg = <0x021ac000 0x4000>;
   };

   mmdc: mmdc@021b0000 {
    compatible = "fsl,imx6ul-mmdc", "fsl,imx6q-mmdc";
    reg = <0x021b0000 0x4000>;
   };

   weim: weim@021b8000 {
    compatible = "fsl,imx6ul-weim", "fsl,imx6q-weim";
    reg = <0x021b8000 0x4000>;
    interrupts = <0 14 4>;
    clocks = <&clks 0>;
   };

   ocotp: ocotp-ctrl@021bc000 {
    compatible = "fsl,imx6ull-ocotp", "syscon";
    reg = <0x021bc000 0x4000>;
    clocks = <&clks 165>;
   };

   csu: csu@021c0000 {
    compatible = "fsl,imx6ul-csu";
    reg = <0x021c0000 0x4000>;
    interrupts = <0 21 4>;
    status = "disabled";
   };

   csi: csi@021c4000 {
    compatible = "fsl,imx6ul-csi", "fsl,imx6s-csi";
    reg = <0x021c4000 0x4000>;
    interrupts = <0 7 4>;
    clocks = <&clks 0>,
     <&clks 138>,
     <&clks 0>;
    clock-names = "disp-axi", "csi_mclk", "disp_dcic";
    status = "disabled";
   };

   lcdif: lcdif@021c8000 {
    compatible = "fsl,imx6ul-lcdif", "fsl,imx28-lcdif";
    reg = <0x021c8000 0x4000>;
    interrupts = <0 5 4>;
    clocks = <&clks 162>,
      <&clks 161>,
      <&clks 0>;
    clock-names = "pix", "axi", "disp_axi";
    status = "disabled";
   };

   pxp: pxp@021cc000 {
    compatible = "fsl,imx6ull-pxp-dma", "fsl,imx7d-pxp-dma";
    reg = <0x021cc000 0x4000>;
    interrupts = <0 8 4>,
     <0 18 4>;
    clocks = <&clks 0>, <&clks 175>;
    clock-names = "pxp_ipg", "pxp_axi";
    status = "disabled";
   };

   qspi: qspi@021e0000 {


    compatible = "fsl,imx6ull-qspi", "fsl,imx6ul-qspi";
    reg = <0x021e0000 0x4000>, <0x60000000 0x10000000>;
    reg-names = "QuadSPI", "QuadSPI-memory";
    interrupts = <0 107 4>;
    clocks = <&clks 176>,
      <&clks 176>;
    clock-names = "qspi_en", "qspi";
    status = "disabled";
   };

   uart2: serial@021e8000 {
    compatible = "fsl,imx6ul-uart",
          "fsl,imx6q-uart", "fsl,imx21-uart";
    reg = <0x021e8000 0x4000>;
    interrupts = <0 27 4>;
    clocks = <&clks 191>,
      <&clks 192>;
    clock-names = "ipg", "per";
    dmas = <&sdma 27 4 0>, <&sdma 28 4 0>;
    dma-names = "rx", "tx";
    status = "disabled";
   };

   uart3: serial@021ec000 {
    compatible = "fsl,imx6ul-uart",
          "fsl,imx6q-uart", "fsl,imx21-uart";
    reg = <0x021ec000 0x4000>;
    interrupts = <0 28 4>;
    clocks = <&clks 193>,
      <&clks 194>;
    clock-names = "ipg", "per";
    dmas = <&sdma 29 4 0>, <&sdma 30 4 0>;
    dma-names = "rx", "tx";
    status = "disabled";
   };

   uart4: serial@021f0000 {
    compatible = "fsl,imx6ul-uart",
          "fsl,imx6q-uart", "fsl,imx21-uart";
    reg = <0x021f0000 0x4000>;
    interrupts = <0 29 4>;
    clocks = <&clks 195>,
      <&clks 196>;
    clock-names = "ipg", "per";
    dmas = <&sdma 31 4 0>, <&sdma 32 4 0>;
    dma-names = "rx", "tx";
    status = "disabled";
   };

   uart5: serial@021f4000 {
    compatible = "fsl,imx6ul-uart",
          "fsl,imx6q-uart", "fsl,imx21-uart";
    reg = <0x021f4000 0x4000>;
    interrupts = <0 30 4>;
    clocks = <&clks 197>,
      <&clks 198>;
    clock-names = "ipg", "per";
    dmas = <&sdma 33 4 0>, <&sdma 34 4 0>;
    dma-names = "rx", "tx";
    status = "disabled";
   };

   i2c4: i2c@021f8000 {


    compatible = "fsl,imx6ul-i2c", "fsl,imx21-i2c";
    reg = <0x021f8000 0x4000>;
    interrupts = <0 35 4>;
    clocks = <&clks 159>;
    status = "disabled";
   };

   uart6: serial@021fc000 {
    compatible = "fsl,imx6ul-uart",
          "fsl,imx6q-uart", "fsl,imx21-uart";
    reg = <0x021fc000 0x4000>;
    interrupts = <0 17 4>;
    clocks = <&clks 199>,
      <&clks 200>;
    clock-names = "ipg", "per";
    dmas = <&sdma 0 4 0>, <&sdma 47 4 0>;
    dma-names = "rx", "tx";
    status = "disabled";
   };
  };

  aips3: aips-bus@02200000 {
   compatible = "fsl,aips-bus", "simple-bus";


   reg = <0x02200000 0x100000>;
   ranges;

   dcp: dcp@02280000 {
    compatible = "fsl,imx6sl-dcp";
    reg = <0x02280000 0x4000>;
    interrupts = <0 46 4>,
          <0 47 4>,
          <0 48 4>;
    clocks = <&clks 230>;
    clock-names = "dcp";
   };

   rngb: rngb@02284000 {
    compatible = "fsl,imx6sl-rng", "fsl,imx-rng", "imx-rng";
    reg = <0x02284000 0x4000>;
    interrupts = <0 6 4>;
    clocks = <&clks 0>;
   };

   uart8: serial@02288000 {
    compatible = "fsl,imx6ul-uart",
          "fsl,imx6q-uart", "fsl,imx21-uart";
    reg = <0x02288000 0x4000>;
    interrupts = <0 40 4>;
    clocks = <&clks 203>,
      <&clks 204>;
    clock-names = "ipg", "per";
    dmas = <&sdma 45 4 0>, <&sdma 46 4 0>;
    dma-names = "rx", "tx";
    status = "disabled";
   };

   epdc: epdc@0228c000 {
    compatible = "fsl,imx7d-epdc";
    interrupts = <0 112 4>;
    reg = <0x0228c000 0x4000>;
    clocks = <&clks 234>,
      <&clks 235>;
    clock-names = "epdc_axi", "epdc_pix";


    status = "disabled";
   };

   iomuxc_snvs: iomuxc-snvs@02290000 {
    compatible = "fsl,imx6ull-iomuxc-snvs";
    reg = <0x02290000 0x10000>;
   };

   snvs_gpr: snvs-gpr@0x02294000 {
    compatible = "fsl, imx6ull-snvs-gpr";
    reg = <0x02294000 0x10000>;
   };
  };
 };
};
# 13 "arch/arm/boot/dts/imx6ull-e60u22a10-base.dts" 2

/ {
 model = "Freescale i.MX6 ULL DDR3 NTX Board";
 compatible = "fsl,imx6ull-ddr3-arm2", "fsl,imx6ull";

 chosen {
  stdout-path = &uart1;
 };

 memory {
  reg = <0x80000000 0x40000000>;
 };

 pxp_v4l2 {
  compatible = "fsl,imx6ul-pxp-v4l2", "fsl,imx6sx-pxp-v4l2", "fsl,imx6sl-pxp-v4l2";
  status = "okay";
 };

 aliases {
  mmc0 = &usdhc2;
  mmc1 = &usdhc1;
 };

 regulators {
  compatible = "simple-bus";



  reg_vref_3v3: regulator@1 {
   compatible = "regulator-fixed";
   regulator-name = "vref-3v3";
   regulator-min-microvolt = <3300000>;
   regulator-max-microvolt = <3300000>;
  };
  reg_sd1_vmmc: wifi_regulator {
   compatible = "regulator-fixed";
   regulator-name = "SD1_SPWR";
   regulator-min-microvolt = <3000000>;
   regulator-max-microvolt = <3000000>;
   wifipwr-gpio = <&gpio5 8 1>;
   wifidis-gpio = <&gpio4 23 0>;
   wifirst-gpio = <&gpio5 7 0>;
   wifiint-gpio = <&gpio5 6 0>;

   btdis-gpio = <&gpio4 22 0>;
   btint-gpio = <&gpio4 24 0>;
  };
 };

 leds {
  compatible = "gpio-leds";
  pinctrl-names = "default";
  pinctrl-0 = <&pinctrl_snvs_led>;

  user {
   label = "GLED";
   gpios = <&gpio5 5 1>;
   1,default-trigger = "timer";
  };
 };

 gpio-keys {
  compatible = "gpio-keys";
  pinctrl-names = "default";
  pinctrl-0 = <&pinctrl_snvs_gpio_keys>;
  power {
   label = "Power";
   gpios = <&gpio5 4 1>;
   btmode0 = <&gpio5 10 1>;
   1,code = <116>;
   gpio-key,wakeup;
  };

  hall {
      label = "Hall";
         gpios = <&gpio5 2 1>;
         1,code = <35> ;
         gpio-key,wakeup;
     };
 };

 usb_plug {
  compatible = "usb_plug";
 };
 ntx_bl {
  compatible = "ntx_bl";
 };
 ntx_led {
  compatible = "ntx_led";
 };
 ntx_event0 {
  compatible = "ntx_event0";
 };
};

&clks {




};

&cpu0 {






 operating-points = <

  900000 1250000
  792000 1200000
  528000 1175000
  396000 1175000
  198000 1175000
 >;
 fsl,soc-operating-points = <

  900000 1250000
  792000 1200000
  528000 1175000
  396000 1175000
  198000 1175000
 >;
 arm-supply = <&reg_arm>;
 soc-supply = <&reg_soc>;



};

&csi {
 status = "disabled";
};

&epdc {
 safe-ticks-turnoff-ep3v3=<400>;
 pinctrl-names = "default";
 pinctrl-0 = <&pinctrl_epdc0>;
 V3P3-supply = <&V3P3_reg>;
 VCOM-supply = <&VCOM_reg>;
 DISPLAY-supply = <&DISPLAY_reg>;
 TMST-supply = <&TMST_reg>;
 status = "okay";
};

&fec1 {
 status = "disabled";
};

&gpc {
 fsl,cpu_pupscr_sw2iso = <0x1>;
 fsl,cpu_pupscr_sw = <0x0>;
 fsl,cpu_pdnscr_iso2sw = <0x1>;
 fsl,cpu_pdnscr_iso = <0x1>;
 fsl,ldo-bypass = <0>;
};

&gpmi {
 pinctrl-names = "default";
 pinctrl-0 = <&pinctrl_gpmi_nand_1>;
 status = "disabled";
 nand-on-flash-bbt;
};

&i2c1 {
 clock-frequency = <100000>;
 pinctrl-names = "default","sleep";
 pinctrl-0 = <&pinctrl_i2c1 &pinctrl_tps65185_gpio &pinctrl_elan_ts_gpio &pinctrl_lm3630a_bl_gpio>;
 pinctrl-1 = <&pinctrl_i2c1_sleep &pinctrl_tps65185_gpio_sleep &pinctrl_elan_ts_gpio_sleep>;
 status = "okay";

 elan_ts@15 {
         compatible = "elan,elan-touch";
         reg = <0x15>;

         gpio_intr = <&gpio1 7 0>;
         gpio_elan_rst = <&gpio1 6 0>;
 };

 lm3630a: lm3630a-i2c@36 {
  reg = <0x36>;
  compatible = "ti,lm3630a_bl";
  gpios = <&gpio3 27 0>;
 };

};

&i2c4 {
 clock-frequency = <100000>;
 pinctrl-names = "default";
 pinctrl-0 = <&pinctrl_i2c4 &pinctrl_ricoh_gpio>;
 status = "okay";

 ricoh619: ricoh619-i2c@32 {
  reg = <0x32>;
  compatible = "ricoh,ricoh619";
  gpios = <&gpio5 1 1>;
  gpio_chg = <&gpio5 0 1>;
  gpio_bat_low = <&gpio5 3 1>;
  battery {
   ricoh,fg-sus-curr = <7420>;
   ricoh,fg-hiber-curr = <560>;
  };
 };
};

# 1 "arch/arm/boot/dts/ricoh619_mx6ull_lpddr2.dtsi" 1
# 14 "arch/arm/boot/dts/ricoh619_mx6ull_lpddr2.dtsi"
&ricoh619
{
 compatible = "ricoh,ricoh619";
 interrupt-controller;


 pwrkey: pwrkey@0 {
  compatible = "ricoh,ricoh619-pwrkey";
  ricoh,pwrkey-delay-ms = <20>;
 };

 rtc {
  compatible = "ricoh,ricoh619-rtc";
  ricoh,rtc-tm-year = <2017>;
  ricoh,rtc-tm-month = <2>;
  ricoh,rtc-tm-mday = <1>;
  ricoh,rtc-tm-hour = <8>;
  ricoh,rtc-tm-min = <0>;
  ricoh,rtc-tm-sec = <0>;
 };

 battery {
  compatible = "ricoh,ricoh619-battery";
  ricoh,alarm-vol-mv = <3250>;
  ricoh,multiple = <100>;
  ricoh,monitor-time = <60>;

  ricoh,ch-vfchg = <0xFF>;
  ricoh,ch-vrchg = <0xFF>;
  ricoh,ch-vbatovset = <0xFF>;
  ricoh,ch-ichg = <0xff>;
  ricoh,ch-ilim-adp = <0xff>;
  ricoh,ch-ilim-usb = <0xff>;
  ricoh,ch-icchg = <0x01>;
  ricoh,fg-target-vsys = <0>;
  ricoh,fg-target-ibat = <0>;
  ricoh,fg-poff-vbat = <3350>;
  ricoh,jt-en = <0>;
  ricoh,jt-hw-sw = <1>;
  ricoh,jt-temp-h = <50>;
  ricoh,jt-temp-l = <12>;
  ricoh,jt-vfchg-h = <0x03>;
  ricoh,jt-vfchg-l = <0>;
  ricoh,jt-ichg-h = <0x0D>;
  ricoh,jt-ichg-l = <0x09>;
 };

 regulators {



  ricoh619_dcdc1_reg: regulator@0 {
   reg = <0>;
   regulator-min-microvolt = <1400000>;
   regulator-max-microvolt = <1400000>;
   regulator-compatible = "ricoh619_dc1";
   regulator-always-on;
   regulator-boot-on;
   regulator-state-mem {
    regulator-on-in-suspend;
    regulator-suspend-microvolt = <900000>;
   };
  };
  ricoh619_dcdc2_reg: regulator@1 {
   reg = <1>;
   regulator-compatible = "ricoh619_dc2";
   regulator-always-on;
   regulator-boot-on;
   regulator-state-mem {
    regulator-on-in-suspend;
    regulator-suspend-microvolt = <3000000>;
   };
  };
  ricoh619_dcdc3_reg: regulator@2 {
   reg = <2>;
   regulator-compatible = "ricoh619_dc3";
   regulator-always-on;
   regulator-boot-on;
  };
  ricoh619_dcdc4_reg: regulator@3 {
   regulator-min-microvolt = <1200000>;
   regulator-max-microvolt = <1200000>;
   reg = <3>;
   regulator-compatible = "ricoh619_dc4";
   regulator-always-on;
   regulator-boot-on;
   regulator-state-mem {
    regulator-on-in-suspend;
    regulator-suspend-microvolt = <1140000>;
   };
  };
  ricoh619_dcdc5_reg: regulator@4 {
   regulator-min-microvolt = <1800000>;
   regulator-max-microvolt = <1800000>;
   reg = <4>;
   regulator-compatible = "ricoh619_dc5";
   regulator-always-on;
   regulator-boot-on;
   regulator-state-mem {
    regulator-on-in-suspend;
    regulator-suspend-microvolt = <1700000>;
   };
  };
  ricoh619_ldo1_reg: regulator@5 {
   reg = <5>;
   regulator-compatible = "ricoh619_ldo1";

   regulator-boot-on;
  };
  ricoh619_ldo2_reg: regulator@6 {
   reg = <6>;
   regulator-compatible = "ricoh619_ldo2";
   regulator-always-on;
   regulator-boot-on;
   regulator-state-mem {
    regulator-on-in-suspend;
    regulator-suspend-microvolt = <3000000>;
   };
  };
  ricoh619_ldo3_reg: regulator@7 {
   reg = <7>;
   regulator-compatible = "ricoh619_ldo3";

   regulator-boot-on;
  };
  ricoh619_ldo4_reg: regulator@8 {
   reg = <8>;
   regulator-compatible = "ricoh619_ldo4";

   regulator-boot-on;
  };
  ricoh619_ldo5_reg: regulator@9 {
   reg = <9>;
   regulator-compatible = "ricoh619_ldo5";
   regulator-always-on;
   regulator-boot-on;
  };
  ricoh619_ldo6_reg: regulator@10 {
   regulator-min-microvolt = <600000>;
   regulator-max-microvolt = <600000>;
   reg = <10>;
   regulator-compatible = "ricoh619_ldo6";
   regulator-always-on;
   regulator-boot-on;
  };
  ricoh619_ldo7_reg: regulator@11 {
   reg = <11>;
   regulator-compatible = "ricoh619_ldo7";
   regulator-always-on;
   regulator-boot-on;
  };
  ricoh619_ldo8_reg: regulator@12 {
   regulator-min-microvolt = <1800000>;
   regulator-max-microvolt = <1800000>;
   reg = <12>;
   regulator-compatible = "ricoh619_ldo8";
   regulator-always-on;
   regulator-boot-on;
  };
  ricoh619_ldo9_reg: regulator@13 {
   reg = <13>;
   regulator-compatible = "ricoh619_ldo9";

   regulator-boot-on;
  };
  ricoh619_ldo10_reg: regulator@14 {
   reg = <14>;
   regulator-compatible = "ricoh619_ldo10";

   regulator-boot-on;
  };
  ricoh619_ldortc1_reg: regulator@15 {
   reg = <15>;
   regulator-compatible = "ricoh619_ldortc1";

   regulator-boot-on;
  };
  ricoh619_ldortc2_reg: regulator@16 {
   reg = <16>;
   regulator-compatible = "ricoh619_ldortc2";

   regulator-boot-on;
  };
 };
};
# 222 "arch/arm/boot/dts/imx6ull-e60u22a10-base.dts" 2

&iomuxc {
 pinctrl-names = "default", "sleep";

 imx6ul-ddr3-arm2 {
  pinctrl_adc1: adc1grp {
   fsl,pins = <
    0x005C 0x02E8 0x0000 0x5 0x0 0xb0
    0x0060 0x02EC 0x0000 0x5 0x0 0xb0
   >;
  };


  pinctrl_csi1: csi1grp {
   fsl,pins = <
    0x01D4 0x0460 0x0000 0x0 0x0 0x1b088
    0x01D8 0x0464 0x0528 0x0 0x1 0x1b088
    0x01DC 0x0468 0x052C 0x0 0x0 0x1b088
    0x01E0 0x046C 0x0524 0x0 0x0 0x1b088
    0x01E4 0x0470 0x04C4 0x0 0x0 0x1b088
    0x01E8 0x0474 0x04C8 0x0 0x0 0x1b088
    0x01EC 0x0478 0x04D8 0x0 0x1 0x1b088
    0x01F0 0x047C 0x04CC 0x0 0x0 0x1b088
    0x01F4 0x0480 0x04DC 0x0 0x1 0x1b088
    0x01F8 0x0484 0x04E0 0x0 0x1 0x1b088
    0x01FC 0x0488 0x04E4 0x0 0x1 0x1b088
    0x0200 0x048C 0x04E8 0x0 0x1 0x1b088
   >;
  };

  pinctrl_ecspi1_cs_1: ecspi1_cs_grp-1 {
   fsl,pins = <
    0x01F8 0x0484 0x0000 0x5 0x0 0x10b0
   >;
  };

  pinctrl_ecspi1_1: ecspi1grp-1 {
   fsl,pins = <
    0x01FC 0x0488 0x053C 0x3 0x1 0x10b0
    0x0200 0x048C 0x0538 0x3 0x1 0x10b0
    0x01F4 0x0480 0x0534 0x3 0x1 0x10b0
   >;
  };

  pinctrl_enet1: enet1grp {
   fsl,pins = <
    0x00CC 0x0358 0x0000 0x0 0x0 0x1b0b0
    0x00E0 0x036C 0x0000 0x0 0x0 0x1b0b0
    0x00C4 0x0350 0x0000 0x0 0x0 0x1b0b0
    0x00C8 0x0354 0x0000 0x0 0x0 0x1b0b0
    0x00D8 0x0364 0x0000 0x0 0x0 0x1b0b0
    0x00D0 0x035C 0x0000 0x0 0x0 0x1b0b0
    0x00D4 0x0360 0x0000 0x0 0x0 0x1b0b0
    0x00DC 0x0368 0x0574 0x4 0x2 0x4001b0a0
   >;
  };

  pinctrl_enet2: enet2grp {
   fsl,pins = <
    0x0078 0x0304 0x0000 0x1 0x0 0x1b098
    0x0074 0x0300 0x0580 0x1 0x0 0x1b0b0
    0x00F0 0x037C 0x0000 0x0 0x0 0x1b0a0
    0x00F4 0x0380 0x0000 0x0 0x0 0x1b0a0
    0x00B4 0x0340 0x0000 0x1 0x0 0x1b0a0
    0x00B8 0x0344 0x0000 0x1 0x0 0x1b0a0
    0x00FC 0x0388 0x0000 0x0 0x0 0x4001b0a8
    0x00F8 0x0384 0x0000 0x0 0x0 0x1b0b0
    0x00E4 0x0370 0x0000 0x0 0x0 0x1b0b0
    0x00E8 0x0374 0x0000 0x0 0x0 0x1b0b0
    0x00A4 0x0330 0x0000 0x1 0x0 0x1b0b0
    0x00A8 0x0334 0x0000 0x1 0x0 0x1b0b0
    0x00EC 0x0378 0x0000 0x0 0x0 0x1b0b0
    0x0100 0x038C 0x0000 0x0 0x0 0x1b0b0
    0x00AC 0x0338 0x0000 0x1 0x0 0x4001b0a8
    0x00C0 0x034C 0x0000 0x1 0x0 0x1b0b0
    0x00BC 0x0348 0x0000 0x1 0x0 0x1b0b0
   >;
  };

        pinctrl_epdc0: epdcgrp0 {
            fsl,pins = <
    0x00E4 0x0370 0x0000 0x9 0x0 0x10b1
    0x00E8 0x0374 0x0000 0x9 0x0 0x10b1
    0x00EC 0x0378 0x0000 0x9 0x0 0x10b1
    0x00F0 0x037C 0x0000 0x9 0x0 0x10b1
    0x00F4 0x0380 0x0000 0x9 0x0 0x10b1
    0x00F8 0x0384 0x0000 0x9 0x0 0x10b1
    0x00FC 0x0388 0x0000 0x9 0x0 0x10b1
    0x0100 0x038C 0x0000 0x9 0x0 0x10b1
    0x0104 0x0390 0x0000 0x9 0x0 0x10b1
    0x0108 0x0394 0x0000 0x9 0x0 0x10b1
    0x010C 0x0398 0x0000 0x9 0x0 0x10b1
    0x0110 0x039C 0x0000 0x9 0x0 0x10b1
    0x0118 0x03A4 0x0000 0x9 0x0 0x10b1
    0x011C 0x03A8 0x0000 0x9 0x0 0x10b1
    0x0120 0x03AC 0x0000 0x9 0x0 0x10b1
    0x0124 0x03B0 0x0000 0x9 0x0 0x10b1
    0x0128 0x03B4 0x0000 0x9 0x0 0x10b1
    0x012C 0x03B8 0x0000 0x9 0x0 0x10b1
    0x0130 0x03BC 0x0000 0x9 0x0 0x10b1
    0x0134 0x03C0 0x0000 0x9 0x0 0x10b1
    0x0150 0x03DC 0x0000 0x9 0x0 0x10b1
    0x0154 0x03E0 0x0000 0x9 0x0 0x10b1
    0x0158 0x03E4 0x0000 0x9 0x0 0x10b1
    0x015C 0x03E8 0x0000 0x9 0x0 0x10b1
    0x0114 0x03A0 0x0000 0x9 0x0 0x10b1
            >;
        };

  pinctrl_esai: esaigrp {
   fsl,pins = <
    0x01E4 0x0470 0x0000 0x9 0x0 0x1b0b0
    0x01E8 0x0474 0x0000 0x9 0x0 0x1b0b0
    0x01F4 0x0480 0x0000 0x9 0x0 0x1b0b0
    0x01F8 0x0484 0x0000 0x9 0x0 0x1b0b0
    0x0200 0x048C 0x0000 0x9 0x0 0x1b0b0
    0x01E0 0x046C 0x0000 0x9 0x0 0x1b0b0
    0x01D8 0x0464 0x0000 0x9 0x0 0x1b0b0
    0x01D4 0x0460 0x0000 0x9 0x0 0x1b0b0
    0x01EC 0x0478 0x0000 0x9 0x0 0x1b0b0
    0x01F0 0x047C 0x0000 0x9 0x0 0x1b0b0
    0x01FC 0x0488 0x0000 0x9 0x0 0x1b0b0
    0x01DC 0x0468 0x0000 0x9 0x0 0x1b0b0
   >;
  };

  pinctrl_flexcan2: flexcan2grp{
   fsl,pins = <
    0x00A0 0x032C 0x0588 0x2 0x0 0x1b020
    0x009C 0x0328 0x0000 0x2 0x0 0x1b020
    0x0058 0x02E4 0x0000 0x5 0x0 0x17059
   >;
  };

  pinctrl_gpmi_nand_1: gpmi-nand-1 {
   fsl,pins = <
    0x01B4 0x0440 0x0000 0x0 0x0 0xb0b1
    0x01A0 0x042C 0x0000 0x0 0x0 0xb0b1
    0x01A4 0x0430 0x0000 0x0 0x0 0xb0b1
    0x01A8 0x0434 0x0000 0x0 0x0 0xb000
    0x01AC 0x0438 0x0000 0x0 0x0 0xb0b1
    0x01B0 0x043C 0x0000 0x0 0x0 0xb0b1
    0x0178 0x0404 0x0000 0x0 0x0 0xb0b1
    0x017C 0x0408 0x0000 0x0 0x0 0xb0b1
    0x0180 0x040C 0x0000 0x0 0x0 0xb0b1
    0x0184 0x0410 0x0000 0x0 0x0 0xb0b1
    0x0188 0x0414 0x0000 0x0 0x0 0xb0b1
    0x018C 0x0418 0x0000 0x0 0x0 0xb0b1
    0x0190 0x041C 0x0000 0x0 0x0 0xb0b1
    0x0194 0x0420 0x0000 0x0 0x0 0xb0b1
    0x0198 0x0424 0x0000 0x0 0x0 0xb0b1
    0x019C 0x0428 0x0000 0x0 0x0 0xb0b1
   >;
  };

  pinctrl_i2c1: i2c1grp {
   fsl,pins = <
    0x00B4 0x0340 0x05A4 0x2 0x1 0x4001F8b0
    0x00B8 0x0344 0x05A8 0x2 0x2 0x4001F8b0
   >;
  };

  pinctrl_i2c1_sleep: i2c1grp_sleep {
   fsl,pins = <
    0x00B4 0x0340 0x05A4 0x2 0x1 0x400108b0
    0x00B8 0x0344 0x05A8 0x2 0x2 0x400108b0
   >;
  };

  pinctrl_i2c4: i2c4grp {
   fsl,pins = <
    0x0094 0x0320 0x05BC 0x2 0x0 0x4001F8b0
    0x0098 0x0324 0x05C0 0x2 0x0 0x4001F8b0
   >;
  };

  pinctrl_i2c4_sleep: i2c4grp_sleep {
   fsl,pins = <
    0x0094 0x0320 0x05BC 0x2 0x0 0x400108b0
    0x0098 0x0324 0x05C0 0x2 0x0 0x400108b0
   >;
  };

  pinctrl_lcdif_dat: lcdifdatgrp {
   fsl,pins = <
    0x0118 0x03A4 0x0000 0x0 0x0 0x79
    0x011C 0x03A8 0x0000 0x0 0x0 0x79
    0x0120 0x03AC 0x0000 0x0 0x0 0x79
    0x0124 0x03B0 0x0000 0x0 0x0 0x79
    0x0128 0x03B4 0x0000 0x0 0x0 0x79
    0x012C 0x03B8 0x0000 0x0 0x0 0x79
    0x0130 0x03BC 0x0000 0x0 0x0 0x79
    0x0134 0x03C0 0x0000 0x0 0x0 0x79
    0x0138 0x03C4 0x0000 0x0 0x0 0x79
    0x013C 0x03C8 0x0000 0x0 0x0 0x79
    0x0140 0x03CC 0x0000 0x0 0x0 0x79
    0x0144 0x03D0 0x0000 0x0 0x0 0x79
    0x0148 0x03D4 0x0000 0x0 0x0 0x79
    0x014C 0x03D8 0x0000 0x0 0x0 0x79
    0x0150 0x03DC 0x0000 0x0 0x0 0x79
    0x0154 0x03E0 0x0000 0x0 0x0 0x79
    0x0158 0x03E4 0x0000 0x0 0x0 0x79
    0x015C 0x03E8 0x0000 0x0 0x0 0x79
    0x0160 0x03EC 0x0000 0x0 0x0 0x79
    0x0164 0x03F0 0x0000 0x0 0x0 0x79
    0x0168 0x03F4 0x0000 0x0 0x0 0x79
    0x016C 0x03F8 0x0000 0x0 0x0 0x79
    0x0170 0x03FC 0x0000 0x0 0x0 0x79
    0x0174 0x0400 0x0000 0x0 0x0 0x79
   >;
  };

  pinctrl_lcdif_ctrl: lcdifctrlgrp {
   fsl,pins = <
    0x0104 0x0390 0x0000 0x0 0x0 0x79
    0x0108 0x0394 0x0000 0x0 0x0 0x79
    0x010C 0x0398 0x05DC 0x0 0x0 0x79
    0x0110 0x039C 0x0000 0x0 0x0 0x79
    0x0114 0x03A0 0x0000 0x0 0x0 0x79
   >;
  };

  pinctrl_mqs: mqsgrp {
   fsl,pins = <
    0x0050 0x02DC 0x0000 0x6 0x0 0x11088
    0x004C 0x02D8 0x0000 0x6 0x0 0x11088
   >;
  };

  pinctrl_pwm1: pmw1grp {
   fsl,pins = <
    0x00C4 0x0350 0x0000 0x2 0x0 0x110b0
   >;
  };

  pinctrl_qspi: qspigrp {
   fsl,pins = <
    0x01A4 0x0430 0x0000 0x2 0x0 0x70a1
    0x01A8 0x0434 0x0000 0x2 0x0 0x70a1
    0x01AC 0x0438 0x0000 0x2 0x0 0x70a1
    0x01B0 0x043C 0x0000 0x2 0x0 0x70a1
    0x01B4 0x0440 0x0000 0x2 0x0 0x70a1
    0x01B8 0x0444 0x0000 0x2 0x0 0x70a1
# 475 "arch/arm/boot/dts/imx6ull-e60u22a10-base.dts"
   >;
  };

  pinctrl_sai2: sai2grp {
   fsl,pins = <
    0x01C4 0x0450 0x05FC 0x2 0x1 0x1b0b0
    0x01C8 0x0454 0x05F8 0x2 0x1 0x1b0b0
    0x01CC 0x0458 0x05F4 0x2 0x1 0x110b0
    0x01D0 0x045C 0x0000 0x2 0x0 0x110b0
    0x01C0 0x044C 0x05F0 0x2 0x1 0x1b0b0
   >;
  };

  pinctrl_uart1: uart1grp {
   fsl,pins = <
    0x0084 0x0310 0x0000 0x0 0x0 0x1b0b1
    0x0088 0x0314 0x0624 0x0 0x3 0x1b0b1
   >;
  };

  pinctrl_uart3: uart3grp {
   fsl,pins = <
    0x00A4 0x0330 0x0000 0x0 0x0 0x1b0b1
    0x00A8 0x0334 0x0634 0x0 0x1 0x1b0b1
    0x00AC 0x0338 0x0000 0x0 0x0 0x1b0b1
    0x00B0 0x033C 0x0630 0x0 0x1 0x1b0b1
   >;
  };

  pinctrl_uart3_dte: uart3dtegrp {
   fsl,pins = <
    0x00A4 0x0330 0x0634 0x0 0x0 0x0b0b0
    0x00A8 0x0334 0x0000 0x0 0x0 0x0b0b0
    0x00AC 0x0338 0x0630 0x0 0x0 0x0b0b0
    0x00B0 0x033C 0x0000 0x0 0x0 0x0b0b0
   >;
  };

  pinctrl_uart3_dte_sleep: uart3dtesleepgrp {
   fsl,pins = <
                0x00A4 0x0330 0x0634 0x0 0x0 0x80000000
                0x00A8 0x0334 0x0000 0x0 0x0 0x80000000
                0x00AC 0x0338 0x0630 0x0 0x0 0x80000000
                0x00B0 0x033C 0x0000 0x0 0x0 0x80000000
            >;
  };

  pinctrl_bt: btgrp {
   fsl,pins = <
    0x01E8 0x0474 0x0000 0x5 0x0 0x80000000
    0x01F0 0x047C 0x0000 0x5 0x0 0x80000000
    0x01EC 0x0478 0x0000 0x5 0x0 0x80000000
   >;
  };

  pinctrl_usb_otg1_id: usbotg1idgrp {
   fsl,pins = <
    0x005C 0x02E8 0x04B8 0x2 0x0 0x17059
   >;
  };

  pinctrl_usb_otg1: usbotg1grp {
   fsl,pins = <
    0x006C 0x02F8 0x0000 0x5 0x0 0x10b0
   >;
  };

  pinctrl_usdhc1: usdhc1grp {
   fsl,pins = <
    0x01BC 0x0448 0x0000 0x0 0x0 0x11059
    0x01C0 0x044C 0x0000 0x0 0x0 0x11059
    0x01C4 0x0450 0x0000 0x0 0x0 0x11059
    0x01C8 0x0454 0x0000 0x0 0x0 0x11059
    0x01CC 0x0458 0x0000 0x0 0x0 0x11059
    0x01D0 0x045C 0x0000 0x0 0x0 0x11059
   >;
  };

  pinctrl_usdhc1_sleep: usdhc1grp_sleep {
   fsl,pins = <
    0x01BC 0x0448 0x0000 0x5 0x0 0x100c1
    0x01C0 0x044C 0x0000 0x5 0x0 0x100c1
    0x01C4 0x0450 0x0000 0x5 0x0 0x100c1
    0x01C8 0x0454 0x0000 0x5 0x0 0x100c1
    0x01CC 0x0458 0x0000 0x5 0x0 0x100c1
    0x01D0 0x045C 0x0000 0x5 0x0 0x100c1
   >;
  };

  pinctrl_usdhc1_100mhz: usdhc1grp100mhz {
   fsl,pins = <
    0x01BC 0x0448 0x0000 0x0 0x0 0x170b9
    0x01C0 0x044C 0x0000 0x0 0x0 0x170b9
    0x01C4 0x0450 0x0000 0x0 0x0 0x170b9
    0x01C8 0x0454 0x0000 0x0 0x0 0x170b9
    0x01CC 0x0458 0x0000 0x0 0x0 0x170b9
    0x01D0 0x045C 0x0000 0x0 0x0 0x170b9
   >;
  };

  pinctrl_usdhc1_200mhz: usdhc1grp200mhz {
   fsl,pins = <
    0x01BC 0x0448 0x0000 0x0 0x0 0x170f9
    0x01C0 0x044C 0x0000 0x0 0x0 0x170f9
    0x01C4 0x0450 0x0000 0x0 0x0 0x170f9
    0x01C8 0x0454 0x0000 0x0 0x0 0x170f9
    0x01CC 0x0458 0x0000 0x0 0x0 0x170f9
    0x01D0 0x045C 0x0000 0x0 0x0 0x170f9
   >;
  };

  pinctrl_usdhc1_8bit: usdhc1_8bit_grp {
   fsl,pins = <
    0x01BC 0x0448 0x0000 0x0 0x0 0x17059
    0x01C0 0x044C 0x0000 0x0 0x0 0x10059
    0x01C4 0x0450 0x0000 0x0 0x0 0x17059
    0x01C8 0x0454 0x0000 0x0 0x0 0x17059
    0x01CC 0x0458 0x0000 0x0 0x0 0x17059
    0x01D0 0x045C 0x0000 0x0 0x0 0x17059
    0x01A8 0x0434 0x0000 0x1 0x0 0x17059
    0x01AC 0x0438 0x0000 0x1 0x0 0x17059
    0x01B0 0x043C 0x0000 0x1 0x0 0x17059
    0x01B4 0x0440 0x0000 0x1 0x0 0x17059
   >;
  };

  pinctrl_usdhc1_8bit_100mhz: usdhc1_8bit_100mhz_grp {
   fsl,pins = <
    0x01BC 0x0448 0x0000 0x0 0x0 0x170b9
    0x01C0 0x044C 0x0000 0x0 0x0 0x100b9
    0x01C4 0x0450 0x0000 0x0 0x0 0x170b9
    0x01C8 0x0454 0x0000 0x0 0x0 0x170b9
    0x01CC 0x0458 0x0000 0x0 0x0 0x170b9
    0x01D0 0x045C 0x0000 0x0 0x0 0x170b9
    0x01A8 0x0434 0x0000 0x1 0x0 0x170b9
    0x01AC 0x0438 0x0000 0x1 0x0 0x170b9
    0x01B0 0x043C 0x0000 0x1 0x0 0x170b9
    0x01B4 0x0440 0x0000 0x1 0x0 0x170b9
   >;
  };

  pinctrl_usdhc1_8bit_200mhz: usdhc1_8bit_200mhz_grp {
   fsl,pins = <
    0x01BC 0x0448 0x0000 0x0 0x0 0x170f9
    0x01C0 0x044C 0x0000 0x0 0x0 0x100f9
    0x01C4 0x0450 0x0000 0x0 0x0 0x170f9
    0x01C8 0x0454 0x0000 0x0 0x0 0x170f9
    0x01CC 0x0458 0x0000 0x0 0x0 0x170f9
    0x01D0 0x045C 0x0000 0x0 0x0 0x170f9
    0x01A8 0x0434 0x0000 0x1 0x0 0x170f9
    0x01AC 0x0438 0x0000 0x1 0x0 0x170f9
    0x01B0 0x043C 0x0000 0x1 0x0 0x170f9
    0x01B4 0x0440 0x0000 0x1 0x0 0x170f9
   >;
  };

  pinctrl_usdhc1_cd_wp: usdhc1_cd_wp_grp {
   fsl,pins = <
    0x0090 0x031C 0x0000 0x5 0x0 0x17059
    0x008C 0x0318 0x0000 0x5 0x0 0x17059
   >;
  };

  pinctrl_elan_ts_gpio: elan_ts_gpio_grp {
   fsl,pins = <
    0x0078 0x0304 0x0000 0x5 0x0 0x17059
    0x0074 0x0300 0x0000 0x5 0x0 0x10059
   >;
  };

  pinctrl_elan_ts_gpio_sleep: elan_ts_gpio_grp_sleep {
   fsl,pins = <
    0x0078 0x0304 0x0000 0x5 0x0 0x10059
    0x0074 0x0300 0x0000 0x5 0x0 0x10059
   >;
  };

  pinctrl_tps65185_gpio: tps65185_gpio_grp {
   fsl,pins = <
    0x013C 0x03C8 0x0000 0x15 0x0 0x10059
    0x0164 0x03F0 0x0000 0x15 0x0 0x10059
    0x0148 0x03D4 0x0000 0x15 0x0 0x10059
    0x0168 0x03F4 0x0000 0x15 0x0 0x10059
    0x00C0 0x034C 0x0000 0x5 0x0 0x17059
    0x00BC 0x0348 0x0000 0x5 0x0 0x17059
   >;
  };

  pinctrl_tps65185_gpio_sleep: tps65185_gpio_sleep_grp {
   fsl,pins = <
    0x013C 0x03C8 0x0000 0x15 0x0 0x10059
    0x0164 0x03F0 0x0000 0x15 0x0 0x10059
    0x0148 0x03D4 0x0000 0x15 0x0 0x10059
    0x0168 0x03F4 0x0000 0x15 0x0 0x10059
    0x00C0 0x034C 0x0000 0x5 0x0 0x13059
    0x00BC 0x0348 0x0000 0x5 0x0 0x13059
   >;
  };

  pinctrl_lm3630a_bl_gpio: lm3630a_bl_gpio_grp {
   fsl,pins = <
    0x0170 0x03FC 0x0000 0x5 0x0 0x17059
   >;
  };

  pinctrl_usdhc1_vselect: usdhc1_vselect_grp {
   fsl,pins = <
    0x0070 0x02FC 0x0000 0x4 0x0 0x17059
   >;
  };

  pinctrl_usdhc2: usdhc2grp {
   fsl,pins = <
    0x017C 0x0408 0x0678 0x1 0x2 0x17059
    0x0178 0x0404 0x0670 0x1 0x2 0x10059
    0x0180 0x040C 0x067C 0x1 0x2 0x17059
    0x0184 0x0410 0x0680 0x1 0x2 0x17059
    0x0188 0x0414 0x0684 0x1 0x1 0x17059
    0x018C 0x0418 0x0688 0x1 0x2 0x17059
   >;
  };

  pinctrl_usdhc2_sleep: usdhc2grp_sleep {
   fsl,pins = <
    0x017C 0x0408 0x0678 0x1 0x2 0x10059
    0x0178 0x0404 0x0670 0x1 0x2 0x10059
    0x0180 0x040C 0x067C 0x1 0x2 0x10059
    0x0184 0x0410 0x0680 0x1 0x2 0x10059
    0x0188 0x0414 0x0684 0x1 0x1 0x10059
    0x018C 0x0418 0x0688 0x1 0x2 0x10059
   >;
  };

  pinctrl_usdhc2_100mhz: usdhc2grp100mhz {
   fsl,pins = <
    0x017C 0x0408 0x0678 0x1 0x2 0x170b9
    0x0178 0x0404 0x0670 0x1 0x2 0x100a9
    0x0180 0x040C 0x067C 0x1 0x2 0x170a9
    0x0184 0x0410 0x0680 0x1 0x2 0x170a9
    0x0188 0x0414 0x0684 0x1 0x1 0x170a9
    0x018C 0x0418 0x0688 0x1 0x2 0x170a9
   >;
  };

  pinctrl_usdhc2_200mhz: usdhc2grp200mhz {
   fsl,pins = <
    0x017C 0x0408 0x0678 0x1 0x2 0x170f9
    0x0178 0x0404 0x0670 0x1 0x2 0x100f9
    0x0180 0x040C 0x067C 0x1 0x2 0x170f9
    0x0184 0x0410 0x0680 0x1 0x2 0x170f9
    0x0188 0x0414 0x0684 0x1 0x1 0x170f9
    0x018C 0x0418 0x0688 0x1 0x2 0x170f9
   >;
  };

  pinctrl_usdhc2_rst: usdhc2_rst_grp {
   fsl,pins = <
    0x01A0 0x042C 0x0000 0x5 0x0 0x17059
   >;
  };
 };
};

&iomuxc_snvs {
 imx6ul-ddr3-arm2 {
  pinctrl_snvs_gpio_keys: gpio_snvs_keys_grp {
   fsl,pins = <
    0x0010 0x0054 0x0000 0x5 0x0 0x17059
    0x0018 0x005C 0x0000 0x5 0x0 0x17059
    0x0014 0x02A0 0x0000 0x5 0x0 0x80000000
   >;
  };

  pinctrl_snvs_led: led_grp {
   fsl,pins = <
    0x001C 0x0060 0x0000 0x5 0x0 0x80000000
   >;
  };

  pinctrl_ricoh_gpio: ricoh_gpio_grp {
   fsl,pins = <
    0x0008 0x004C 0x0000 0x5 0x0 0x17059
    0x000C 0x0050 0x0000 0x5 0x0 0x17059
    0x0014 0x0058 0x0000 0x5 0x0 0x17059
   >;
  };

  pinctrl_usdhc1_pwr: usdhc1_pwr_grp {
   fsl,pins = <
    0x0020 0x0064 0x0000 0x5 0x0 0x10059
    0x0024 0x0068 0x0000 0x5 0x0 0x10059
    0x0028 0x006C 0x0000 0x5 0x0 0x10059
   >;
  };

 };
};

&lcdif {
 pinctrl-names = "default";
 pinctrl-0 = <&pinctrl_lcdif_dat
       &pinctrl_lcdif_ctrl>;
 display = <&display0>;
 status = "disabled";

 display0: display {
  bits-per-pixel = <16>;
  bus-width = <24>;

  display-timings {
   native-mode = <&timing0>;
   timing0: timing0 {
    clock-frequency = <33500000>;
    hactive = <800>;
    vactive = <480>;
    hback-porch = <89>;
    hfront-porch = <164>;
    vback-porch = <23>;
    vfront-porch = <10>;
    hsync-len = <10>;
    vsync-len = <10>;
    hsync-active = <0>;
    vsync-active = <0>;
    de-active = <1>;
    pixelclk-active = <0>;
   };
  };
 };
};

&pwm1 {
 pinctrl-names = "default";
 pinctrl-0 = <&pinctrl_pwm1>;
 status = "disabled";
};

&pxp {
 status = "okay";
};

&qspi {
 pinctrl-names = "default";
 pinctrl-0 = <&pinctrl_qspi>;
 status = "disabled";



 ddrsmp=<0>;
};

&uart1 {
 pinctrl-names = "default";
 pinctrl-0 = <&pinctrl_uart1>;
 status = "okay";
};

&uart2 {
 pinctrl-names = "default";
 fsl,uart-has-rtscts;

 fsl,dte-mode;

 status = "disabled";
};

&uart3 {
 pinctrl-names = "default","sleep";
 fsl,uart-has-rtscts;
 fsl,dte-mode;
 pinctrl-0 = <&pinctrl_uart3_dte>, <&pinctrl_bt>;
 pinctrl-1 = <&pinctrl_uart3_dte_sleep>;
 status = "okay";
};

&usbotg1 {
 dr_mode = "otg";
 srp-disable;
 hnp-disable;
 adp-disable;
 status = "okay";
};

&usdhc1 {
 pinctrl-names = "default", "state_100mhz", "state_200mhz", "sleep";
 pinctrl-0 = <&pinctrl_usdhc1>, <&pinctrl_usdhc1_pwr>;
 pinctrl-1 = <&pinctrl_usdhc1_100mhz>;
 pinctrl-2 = <&pinctrl_usdhc1_200mhz>;
 pinctrl-3 = <&pinctrl_usdhc1_sleep>, <&pinctrl_usdhc1_pwr>;
 vmmc-supply = <&reg_sd1_vmmc>;
 wifi-host;
 status = "okay";
};

&usdhc2 {
 pinctrl-names = "default","sleep";
 pinctrl-0 = <&pinctrl_usdhc2>;
 pinctrl-1 = <&pinctrl_usdhc2_sleep>;
 non-removable;
 no-1-8-v;
 keep-power-in-suspend;
 status = "okay";
};
# 3 "arch/arm/boot/dts/imx6ull-e60u22a10.dts" 2

&i2c1 {
 tps6518x@68 {
      compatible = "ti,tps6518x";
      reg = <0x68>;



      pwr_seq0 = <0xe1>;
      pwr_seq1 = <0x30>;
      pwr_seq2 = <0x33>;



      upseq0 = <0xe1>;
      upseq1 = <0x00>;
      dwnseq0 = <0x1e>;
      dwnseq1 = <0xe0>;

      gpio_pmic_pwrgood = <&gpio2 13 0>;
      gpio_pmic_vcom_ctrl = <&gpio2 3 0>;
      gpio_pmic_wakeup = <&gpio2 7 0>;
      gpio_pmic_powerup = <&gpio2 8 0>;
      gpio_pmic_intr = <&gpio2 9 0>;


      gpio_pmic_pwrall = <&gpio2 14 0>;

      regulators {
          DISPLAY_reg: DISPLAY {
              regulator-name = "DISPLAY";
          };

       VCOM_reg: VCOM {
           regulator-name = "VCOM";

           regulator-min-microvolt = <0xffbe0178>;

           regulator-max-microvolt = <0xfff85ee0>;
       };

       V3P3_reg: V3P3 {
           regulator-name = "V3P3";
       };

       TMST_reg: TMST {
           regulator-name = "TMST";
       };

  };
 };
};

&i2c1 {
 sy7636@62 {
     compatible = "Silergy,sy7636";
     reg = <0x62>;
# 68 "arch/arm/boot/dts/imx6ull-e60u22a10.dts"
        on_delay1 = <0x2>;
        on_delay2 = <0x2>;
        on_delay3 = <0x2>;
        on_delay4 = <0x2>;

  turnoff_delay_ep3v3 = <100>;
# 88 "arch/arm/boot/dts/imx6ull-e60u22a10.dts"
        gpio_pmic_pwrgood = <&gpio1 13 0>;
        gpio_pmic_vcom_ctrl = <&gpio3 24 0>;
        gpio_pmic_powerup = <&gpio3 25 0>;


        gpio_pmic_pwrall = <&gpio3 14 0>;

        regulators {
         DISPLAY_SY7636_reg: DISPLAY_SY7636 {
                   regulator-name = "DISPLAY_SY7636";
            };

            VCOM_SY7636_reg: VCOM_SY7636 {
                   regulator-name = "VCOM_SY7636";

                   regulator-min-microvolt = <0xffbe0178>;

                   regulator-max-microvolt = <0xfff85ee0>;
            };

            V3P3_SY7636_reg: V3P3_SY7636 {
                   regulator-name = "V3P3_SY7636";
            };

            TMST_SY7636_reg: TMST_SY7636 {
                regulator-name = "TMST_SY7636";
            };
        };
 };
};
